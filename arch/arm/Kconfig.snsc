## arch/arm/Kconfig.snsc
```kconfig
#
# SNSC related configurations
#
config SNSC_ARM_REDUCE_ICACHE_INVALIDATION
       bool "Reduce I-cache invalidation on ARM v6 and later"
       depends on SNSC
       depends on CPU_CACHE_V6 || CPU_CACHE_V7
       default n

config SNSC_VFP_DETECTION
	bool "VFP detection"
	depends on VFP
	depends on SNSC
	default n

config SNSC_VFP_DETECTION_IRQ
	bool "VFP detection in IRQ context"
	depends on SNSC_VFP_DETECTION
	default n
	help
	  Enable this option to detect VFP instruction in IRQ context.
	  kernel will raise warning if VFP instruction executed in
	  IRQ context.

	  If unsure, say N.

config SNSC_VFP_DETECTION_IOCTL
	bool "VFP detection in ioctl context"
	depends on SNSC_VFP_DETECTION
	default n
	help
	  Enable this option to detect VFP instruction in ioctl context.
	  kernel will raise warning if VFP instruction executed in ioctl
	  context.

	  If unsure, say N.
```

## arch/arm/configs/sunxi_defconfig
```kconfig
CONFIG_LOCALVERSION="-sunxi"
CONFIG_KERNEL_XZ=y
CONFIG_IRQ_DOMAIN_DEBUG=y
CONFIG_NO_HZ=y
CONFIG_HIGH_RES_TIMERS=y
CONFIG_IKCONFIG=y
CONFIG_IKCONFIG_PROC=y
CONFIG_BLK_DEV_INITRD=y
CONFIG_INITRAMFS_COMPRESSION_XZ=y
CONFIG_CC_OPTIMIZE_FOR_SIZE=y
CONFIG_MODULES=y
CONFIG_ARCH_SUNXI=y
CONFIG_ARCH_VIRT=y
CONFIG_ARM_ERRATA_720789=y
CONFIG_ARM_ERRATA_754322=y
CONFIG_ARM_ERRATA_754327=y
CONFIG_ARM_ERRATA_764369=y
CONFIG_ARM_ERRATA_775420=y
CONFIG_ARM_ERRATA_798181=y
CONFIG_SMP=y
CONFIG_SCHED_MC=y
CONFIG_HAVE_ARM_ARCH_TIMER=y
CONFIG_AEABI=y
CONFIG_HIGHMEM=y
CONFIG_HIGHPTE=y
CONFIG_ARM_APPENDED_DTB=y
CONFIG_CPU_IDLE=y
CONFIG_VFP=y
CONFIG_NEON=y
CONFIG_PM_RUNTIME=y
CONFIG_NET=y
CONFIG_PACKET=y
CONFIG_PACKET_DIAG=y
CONFIG_UNIX=y
CONFIG_UNIX_DIAG=y
CONFIG_INET=y
CONFIG_IP_PNP=y
CONFIG_IP_PNP_DHCP=y
# CONFIG_INET_XFRM_MODE_TRANSPORT is not set
# CONFIG_INET_XFRM_MODE_TUNNEL is not set
# CONFIG_INET_XFRM_MODE_BEET is not set
# CONFIG_INET_LRO is not set
CONFIG_IPV6=y
# CONFIG_INET6_XFRM_MODE_TRANSPORT is not set
# CONFIG_INET6_XFRM_MODE_TUNNEL is not set
# CONFIG_INET6_XFRM_MODE_BEET is not set
CONFIG_IPV6_SIT=m
CONFIG_DEVTMPFS=y
CONFIG_DEVTMPFS_MOUNT=y
CONFIG_PROC_DEVICETREE=y
CONFIG_EEPROM_SUNXI_SID=y
CONFIG_BLK_DEV_SD=y
CONFIG_ATA=y
CONFIG_SATA_AHCI_PLATFORM=y
# CONFIG_ATA_SFF is not set
CONFIG_NETDEVICES=y
CONFIG_ETHERNET=y
CONFIG_TUN=m
CONFIG_SUN4I_EMAC=y
# CONFIG_NET_CADENCE is not set
# CONFIG_NET_VENDOR_BROADCOM is not set
# CONFIG_NET_VENDOR_CIRRUS is not set
# CONFIG_NET_VENDOR_FARADAY is not set
# CONFIG_NET_VENDOR_INTEL is not set
# CONFIG_NET_VENDOR_MARVELL is not set
# CONFIG_NET_VENDOR_MICREL is not set
CONFIG_ENC28J60=m
# CONFIG_NET_VENDOR_NATSEMI is not set
# CONFIG_NET_VENDOR_SEEQ is not set
# CONFIG_NET_VENDOR_SMSC is not set
# CONFIG_NET_VENDOR_WIZNET is not set
CONFIG_NET_VENDOR_STMICRO=y
CONFIG_STMMAC_ETH=y
CONFIG_STMMAC_PLATFORM=y
CONFIG_DWMAC_SUNXI=y
CONFIG_PHYLIB=y
CONFIG_REALTEK_PHY=y
CONFIG_SERIAL_8250=y
# CONFIG_SERIAL_8250_DEPRECATED_OPTIONS is not set
CONFIG_SERIAL_8250_CONSOLE=y
CONFIG_SERIAL_8250_DW=y
CONFIG_I2C=y
CONFIG_I2C_MV64XXX=y
CONFIG_SPI=y
CONFIG_SPI_BITBANG=y
CONFIG_PTP_1588_CLOCK=y
CONFIG_PINCTRL_SINGLE=y
CONFIG_GPIO_GENERIC_PLATFORM=y
CONFIG_POWER_SUPPLY=y
CONFIG_POWER_RESET=y
CONFIG_POWER_RESET_GPIO=y
CONFIG_POWER_RESET_RESTART=y
CONFIG_USB=y
CONFIG_USB_ANNOUNCE_NEW_DEVICES=y
CONFIG_USB_STORAGE=y
CONFIG_MMC=y
CONFIG_MMC_SDHCI=y
CONFIG_MMC_SDHCI_PLTFM=y
CONFIG_NEW_LEDS=y
CONFIG_LEDS_CLASS=y
CONFIG_LEDS_GPIO=y
CONFIG_EDAC=y
CONFIG_EDAC_MM_EDAC=y
CONFIG_RTC_CLASS=y
CONFIG_DMADEVICES=y
CONFIG_DW_DMAC=y
CONFIG_MAILBOX=y
CONFIG_PWM=y
CONFIG_RESET_CONTROLLER=y
CONFIG_EXT4_FS=y
CONFIG_FANOTIFY=y
CONFIG_FUSE_FS=m
CONFIG_CUSE=m
CONFIG_ISO9660_FS=m
CONFIG_JOLIET=y
CONFIG_ZISOFS=y
CONFIG_MSDOS_FS=m
CONFIG_VFAT_FS=m
CONFIG_TMPFS=y
CONFIG_SQUASHFS=y
CONFIG_SQUASHFS_LZO=y
CONFIG_SQUASHFS_XZ=y
CONFIG_NFS_FS=y
CONFIG_NFS_V3_ACL=y
CONFIG_NFS_V4=y
CONFIG_NFS_V4_1=y
CONFIG_ROOT_NFS=y
CONFIG_NLS_DEFAULT="UTF-8"
CONFIG_NLS_UTF8=m
CONFIG_PRINTK_TIME=y
CONFIG_MAGIC_SYSRQ=y
CONFIG_DEBUG_FS=y
CONFIG_DEBUG_KERNEL=y
CONFIG_LOCKUP_DETECTOR=y
# CONFIG_FTRACE is not set
CONFIG_DYNAMIC_DEBUG=y
CONFIG_DEBUG_LL=y
CONFIG_EARLY_PRINTK=y
```

## block/Kconfig.snsc
```kconfig
if BLOCK

menu "SNSC Configurations"

comment "SNSC related options"
	depends on SNSC

config SNSC_BLOCK_K3D
	bool "Enable k3d (Kernel Disk Detection Daemon)"
	depends on SNSC
	default y
	select SNSC_USB_STOR_REMOVABLE_ALL

config SNSC_BLOCK_K3D_INTERVAL
	int "Default interval duration to check media status (millisecond)"
	depends on SNSC
	depends on SNSC_BLOCK_K3D
	default 1000

config SNSC_BLOCK_CHECK_DISK
	bool "Enable to check disk for block device file"
	depends on SNSC
	depends on SNSC_BLOCK_K3D

config SNSC_BLOCK_MESSAGE_SILENT
 	bool "Suppress Block messages"
	depends on (64BIT || LBDAF)


endmenu

endif # BLOCK
```

## block/partitions/Kconfig.snsc
```kconfig
comment "SNSC related options"
	depends on SNSC

config SNSC_PARTITION_MESSAGE_SILENT
	bool "Suppress FileSystem Partition messages"
```

## drivers/char/hifc/Kconfig
```kconfig
#
# CXD5602 HostIFC device configuration
#

menu 'CXD5602 HostIFC protocol'
config HIFC_MSG_DISP
	tristate 'CXD5602 HostIFC protocol message dispatch handler'
	---help---
		If you say Y here and create a character special device named hifc-i2c,
		you can read or write data from/to CXD5602 HAPs through it.
		Generally it connets the CXD5602 HAPs through I2C or SPI.
		Consequentl you should config the low level drivers.

choice
	prompt "Select HostIFC low level drivers interface"
	default HIFC_DRVIF_SPI
	depends on HIFC_MSG_DISP

config HIFC_DRVIF_I2C
	bool 'I2C Driver'
	depends on I2C
	---help---
		Use the I2C as the low level driver interface.

config HIFC_DRVIF_SPI
	bool 'SPI Driver'
	depends on SPI_MASTER
	---help---
		Use the SPI as the low level driver interface.
endchoice
endmenu
```

## drivers/hss/Kconfig
```kconfig
#
# HSS configuration
#

menu "SNSC Hierarchical Suspend Set (HSS)"

config SNSC_HSS
	bool "HSS core"
	depends on PM
	---help---
	  HSS enables that conforming drivers can be called in the
	  specified order regarding their parent/children relation ship.

	  If unsure, say N

config SNSC_HSS_DEBUG
        depends on SNSC_HSS
	depends on SYSFS
	bool "Enable sysfs entries for HSS"
	---help---
	  This enables support for sysdev entries which contain
	  sevaral internal values of each HSS node. Note that enabling
          this option involves the increase of code/data size.

          If unsure, say N

config SNSC_HSS_VERBOSE_OUTPUT
       depends on SNSC_HSS
       bool "Verbose output of the node state changes"
       ---help---
         This enable the verbose output for what the HSS core does on
         each nodes.
         Disabling this saves the code size.

         If unsure, say N
endmenu
```

## drivers/iio/accel_gyro/Kconfig
```kconfig
#
# Accelerometer and gyroscope drivers
#
menu "Accelerometers and gyroscopes"

config IIO_BMI160_ACCEL_GYRO_6AXIS
	tristate "BMI160 accelerometer and gyroscope 6-Axis Driver"
	depends on (I2C || SPI_MASTER) && SYSFS
	select IIO_BMI160_CORE
	select IIO_BMI160_ACCEL_GYRO_I2C_6AXIS if (I2C)
	select IIO_BMI160_ACCEL_GYRO_SPI_6AXIS if (SPI_MASTER)
	select IIO_KFIFO_BUF if (IIO_BUFFER)
	help
	  Say yes here to build support for a BMI160 accelerometer and gyroscope

	  This driver can also be built as a module. If so, will be created
	  these modules:
	  - bmi160_accel_gyro (core functions for the driver [it is mandatory]);
	  - bmi160_accel_gyro_i2c (necessary for the I2C devices [optional*]);
	  - bmi160_accel_gyro_spi (necessary for the SPI devices [optional*]);

	  (*) one of these is necessary to do something.

config IIO_BMI160_ACCEL_GYRO_I2C_6AXIS
	tristate
	depends on IIO_BMI160_ACCEL_GYRO_6AXIS
	depends on IIO_BMI160_I2C

config IIO_BMI160_ACCEL_GYRO_SPI_6AXIS
	tristate
	depends on IIO_BMI160_ACCEL_GYRO_6AXIS
	depends on IIO_BMI160_SPI

endmenu
```

## drivers/iio/common/bmi160/Kconfig
```kconfig
#
# BMI160 common library
#

if IIO_BMI160_ACCEL_3AXIS || IIO_BMI160_GYRO_3AXIS || IIO_BMI160_ACCEL_GYRO_6AXIS

menu "BMI160 IIO common"

config IIO_BMI160_I2C
	tristate

config IIO_BMI160_SPI
	tristate

config IIO_BMI160_CORE
	tristate
	select IIO_BMI160_I2C if I2C
	select IIO_BMI160_SPI if SPI_MASTER

config IIO_BMI160_CONTINUE_UNKNOWN_REG_CHIPID
	bool "Continue if the value of CHIPID register is unknown"
	default y
	help
	  In the datasheet, some descrptions define the value of CHIPID register to
	  be 0xd0, and others describe it is TBD. Actually, there is a chip which
	  contains 0xd1 as the value. If yes, when unknown value is read as the
	  CHIPID on probing, warning message is displayed and probing device is
	  continued.

config IIO_BMI160_DIRECT_BURST_READ
	bool "Burst read extension in direct mode"
	default y
	help
	  Supports burst read of X, Y and Z axis of sensor(s) data in direct mode.

config IIO_BMI160_USE_GPIO_IRQ
	bool "Use GPIO for IRQ"
	default y

config IIO_BMI160_SKIP_FIFO_FULL_CHECK
	bool "Skip checking FIFO full status"
	default n

endmenu

endif
```

## drivers/iommu/Kconfig.snsc
```kconfig
config SNSC_CREATE_FAKE_IVMD_FOR_VIA_XHCI_ON_GA_F2A88X_UP4
        bool "Create fake IVMD for VIA XHCI on GA-F2A88X-UP4"
        depends on SNSC
        depends on AMD_IOMMU
        help
          Make VIA USB XHCI work on Gigabyte board GA-F2A88X-UP4.
          VIA XHCI HW accesses a physical address directly which is not
          excluded in ACPI table presented by BIOS.
          This is a temp solution to build a fake IVMD table in amd iommu
          driver to prevent IOMMU translating the physical address.
```

## drivers/net/ethernet/realtek/r8168/Kconfig
```kconfig
config R8168
	tristate "Realtek 8168 gigabit ethernet support"
	depends on PCI
	select CRC32
	select NET_CORE
	select MII
	---help---
	  Say Y here if you have a Realtek 8168 PCI Gigabit Ethernet adapter.

	  To compile this driver as a module, choose M here: the module
	  will be called r8168.

if R8168

config R8168_ENABLE_REALWOW_SUPPORT
	bool
	default n

config R8168_ENABLE_DASH_SUPPORT
	bool
	default n

config R8168_CONFIG_DOWN_SPEED_100
	bool
	default n

config R8168_CONFIG_ASPM
	bool
	default y

config R8168_ENABLE_S5WOL
	bool
	default y

config R8168_ENABLE_EEE
	bool
	default n

endif # R8168
```

## drivers/scsi/Kconfig.snsc
```kconfig
comment "SNSC related options"
	depends on SNSC

config SNSC_SCSI_MESSAGE_SILENT
	bool "Suppress SCSI messages"

config SNSC_SCSI_SD_RW10_DEFAULT
	bool "Use READ/WRITE_10 command as default."
	depends on SNSC
	depends on BLK_DEV_SD

config SNSC_SCSI_SD_NEED_REVALIDATE
	bool "Revalidate the disk again at open, if the medium is changed."
	depends on SNSC
	depends on BLK_DEV_SD

config SNSC_SCSI_PROC_DEVICE_NAME
	bool "Print the device name on /proc/scsi"
	depends on SCSI && PROC_FS && SCSI_PROC_FS

config SNSC_SCSI_SD_REUSE_INDEX
	bool "Reuse sd,sr index that is mounted but the device is removed."
	depends on SNSC
	depends on BLK_DEV_SD

config SNSC_SCSI_REUSE_HOST_NO
	bool "Reuse scsi host number"
	depends on SNSC
	depends on BLK_DEV_SD
	help
	  Clear scsi host number, when all scsi host is removed
	  using the same scsi host template.

config SNSC_SCSI_PARAM_SD_TIMEOUT
	bool "Introduce snsc_sd_timeout to control SCSI disk timeout"
	depends on SNSC
	depends on BLK_DEV_SD
	help
	  2.6.16: The default is 30.
	  CEE30 : The default is 6.
	  CEE30 : The value in dtg3G and selecao is 30.

config SNSC_SCSI_ERROR_NOT_RETRY_CMD_MEDIUM_CHANGED
	bool "Not retry the command if the medium was changed"
	depends on SNSC
	depends on SCSI
	depends on SNSC_USB_STORAGE_ADDITIONAL_UNUSUAL_DEVS

config SNSC_SCSI_SD_CHK_SYNCHRONIZE_CACHE_SUPPORT
	bool "Check SYNCHRONIZE CACHE command support"
	depends on SNSC
	depends on BLK_DEV_SD
```

## drivers/staging/amd_imc/Kconfig
```kconfig
config AMD_IMC
	bool "AMD Intergrated Micro Controller support"
	depends on PCI && X86_64
	default y
	---help---
	  This driver supports AMD Intergrated Micro Controller.

	  To compile this driver as a module, choose M here. The module
	  will be called amd_imc.
```

## drivers/staging/iio/Kconfig
```kconfig
#
# Industrial I/O subsystem configuration
#
menu "IIO staging drivers"
	depends on IIO

source "drivers/staging/iio/accel/Kconfig"
source "drivers/staging/iio/adc/Kconfig"
source "drivers/staging/iio/addac/Kconfig"
source "drivers/staging/iio/cdc/Kconfig"
source "drivers/staging/iio/frequency/Kconfig"
source "drivers/staging/iio/gyro/Kconfig"
source "drivers/staging/iio/impedance-analyzer/Kconfig"
source "drivers/staging/iio/light/Kconfig"
source "drivers/staging/iio/magnetometer/Kconfig"
source "drivers/staging/iio/meter/Kconfig"
source "drivers/staging/iio/resolver/Kconfig"
source "drivers/staging/iio/trigger/Kconfig"

config IIO_DUMMY_EVGEN
       tristate

config IIO_SIMPLE_DUMMY
       tristate "An example driver with no hardware requirements"
       help
	 Driver intended mainly as documentation for how to write
	 a driver. May also be useful for testing userspace code
	 without hardware.

if IIO_SIMPLE_DUMMY

config IIO_SIMPLE_DUMMY_EVENTS
       boolean "Event generation support"
       select IIO_DUMMY_EVGEN
       help
         Add some dummy events to the simple dummy driver.

config IIO_SIMPLE_DUMMY_BUFFER
       boolean "Buffered capture support"
       depends on IIO_KFIFO_BUF
       help
         Add buffered data capture to the simple dummy driver.

endif # IIO_SIMPLE_DUMMY

config IIO_SIMPLE_SIM
       tristate "IIO simulator"
       depends on !IIO_SIMPLE_DUMMY
       select IIO_BUFFER
       select IIO_KFIFO_BUF
       help
         Enable IIO simulator

if IIO_SIMPLE_SIM

config IIO_SIMPLE_SIM_BUFFER
       boolean "Buffered capture support"
       depends on IIO_KFIFO_BUF
       default y
       help
         Enable buffered capture support in simulator

config IIO_SIMPLE_SIM_HARDWARE_BUFFER_MODE
       boolean "Hardware buffer mode simulation support"
       depends on IIO_SIMPLE_SIM_BUFFER
       default y
       help
         If enabled, hardware buffer mode simulation is activated.
         If disabled, hardware trigger mode simulation is activated.

config IIO_SIMPLE_SIM_HARDWARE_BUFFER_SIZE
       int "Simulated hardware buffer size"
       depends on IIO_SIMPLE_SIM_HARDWARE_BUFFER_MODE
       default 4096
       range 2 4096
       help
         Simulated FIFO size for hardware buffer mode.
         This value should be the power of 2; otherwise the behavior will be
         unexpected.

endif # IIO_SIMPLE_SIM

endmenu
```

## drivers/usb/Kconfig.snsc
```kconfig
comment "SNSC related options"
	depends on SNSC

config SNSC_USB_MESSAGE_SILENT
	bool "Suppress USB messages"
	depends on SNSC
	depends on USB
	select SNSC_BLOCK_MESSAGE_SILENT
	select SNSC_PARTITION_MESSAGE_SILENT
	select SNSC_SCSI_MESSAGE_SILENT

config SNSC_USB_QUICK_BOOT
	bool "Shorten boot time initialization"
	depends on SNSC
	depends on USB
	select SNSC_USB_HOST_QUICK_BOOT

config SNSC_USB_SINGLE_STEP_CTRL
	bool "Send conrol transfer step by step"
	depends on SNSC
	depends on USB
	default n
```
