## drivers/usb/core/Kconfig.snsc
```kconfig
comment "SNSC related options"
	depends on SNSC

config SNSC_USB_ROOT_HUB_ONLY
	bool "Disable external USB hubs"
	depends on SNSC
	depends on USB

config SNSC_USB_PORT_INIT_CTRL_GET_TIMEOUT_OPTION
	bool "Enable to set timeout for device descriptor fetch at port initialization."
	depends on SNSC
	depends on USB
	default y

config SNSC_USB_HUB_ADD_OC_STATUS_ATTR
	bool "Add Over-Current Status attribute for each hub."
	depends on SNSC
	depends on USB
	default n
	help
	  This attribute shows over-current status as a bitmap.
	  Bit 1-31 are assgigned for each port.
	  Bit 0 is assigned for a hub basis.

config SNSC_USB_HUB_ADD_OC_STATUS_ATTR_OC_CHANGE
	bool "Treat Over-Current Change as Over-Current Status."
	depends on SNSC_USB_HUB_ADD_OC_STATUS_ATTR
	default n

config SNSC_USB_HUB_UEVENT_OC_CHANGE
	bool "Notfiy Over-Current Change uevent for each hub."
	depends on SNSC
	depends on USB && HOTPLUG
	default n
	help
	  This attribute shows over-current change as a bitmap.
	  Bit 1-31 are assgigned for each port.
	  Bit 0 is assigned for a hub basis.

config SNSC_USB_HUB_PORT_OC_RECOVERY_AFTER_UEVENT
	bool "Recover the hub port power from over-current status after uevent."
	depends on SNSC
	depends on USB && SNSC_USB_HUB_UEVENT_OC_CHANGE
	default n
	help
	  This config adds module_param(hub_oc_recovery_wait) to set
	  USB hub over-curent recovery wait time [ms] before enable port power.
	  0 means waiting forever i.e. not power on.

config SNSC_USB_HUB_PORT_INIT_TIMEOUT_NO_RETRY
	bool "Abort retry if timeout has occurred in hub port init process."
	depends on SNSC
	depends on USB

config SNSC_USB_PORT_INIT_CTRL_GET_TIMEOUT
	int "Timeout(msec) for device descriptor fetch at port initialization."
	depends on SNSC_USB_PORT_INIT_CTRL_GET_TIMEOUT_OPTION
	default 10000
	help
	  5000 msec is default timeout value in linux kernel,
	  but some devices can't response in 5000 msec.
	  DSC-P2 sometimes needs about 7000 msec,
	  so CE Linux kernel sets this timeout to 10000 msec.

config SNSC_USB_HUB_CONFIRM_RX_DETECT_AT_PORT_DISABLE
	bool "Confirm the port is Rx.Detect state when disable the port"
	depends on SNSC
	depends on USB
	default y
	help
	  This config confirms the USB3.0 port is set to Rx.Detect state
	  during port disabling. If the port failed to set Rx.Detect,
	  the port cannot detect any device connects or disconnects.
	  For example, the port of AMD A88X HC could not be set to
	  Rx.Detect without this config.
```

## drivers/usb/host/Kconfig.snsc
```kconfig
comment "SNSC related options"
	depends on SNSC

config SNSC_USB_HOST_QUICK_BOOT
	bool "Shorten boot time initialization"
	depends on SNSC
	depends on SNSC_USB_QUICK_BOOT

comment "EHCI HCD (USB 2.0) related options"
	depends on SNSC
	depends on USB_EHCI_HCD

config SNSC_USB_EHCI_OVERRIDE_PWRON2PWRGOOD
	bool "Override default EHCI PwrOn2PwrGOOD"
        depends on SNSC
	depends on USB_EHCI_HCD
	depends on SNSC_USB_HOST_QUICK_BOOT

config SNSC_USB_EHCI_PWRON2PWRGOOD
	int "Delay time after port power on (ms)"
	depends on SNSC_USB_EHCI_OVERRIDE_PWRON2PWRGOOD
	default "20"

comment "OHCI HCD related options"
	depends on SNSC
	depends on USB_OHCI_HCD

config SNSC_USB_OHCI_OVERRIDE_PWRON2PWRGOOD
	bool "Override default OHCI PwrOn2PwrGOOD"
        depends on SNSC
	depends on USB_OHCI_HCD
	depends on SNSC_USB_HOST_QUICK_BOOT

config SNSC_USB_OHCI_PWRON2PWRGOOD
	int "Delay time after port power on (ms)"
	depends on SNSC_USB_OHCI_OVERRIDE_PWRON2PWRGOOD
	default "20"

config SNSC_USB_RH_PORT_POWER_CONTROL_XHCI_WITH_PAIR
bool "Control root hub port power with pair for xhci."
	depends on SNSC
	depends on USB_XHCI_HCD
	default n
```

## drivers/usb/storage/Kconfig.snsc
```kconfig
comment "SNSC related options"
	depends on SNSC

config SNSC_USB_STORAGE_TRANSPORT_RESET_FIRST
	bool "First transport reset is tried, before port reset"
	depends on SNSC
	depends on USB_STORAGE
	help
	  According to BOT and CBI transport specifications,
	  Port Reset should be used as the last means.

	  for MSAC-US40(BOT) + MemoryStickPro

config SNSC_USB_STORAGE_USE_GFP_NOWAIT_OR_ATOMIC
	bool "Use GFP_NOWAIT or GFP_ATOMIC in a USB storage driver"
	depends on SNSC
	depends on USB_STORAGE
	help
	  To avoid a memory starvation with swap areas on a USB HDD,
	  use GFP_NOWAIT or GFP_ATOMIC instead of GFP_NOIO
	  in the USB storage driver.

config SNSC_USB_STOR_PARAM_DID_ABORT_RETRY_MAX
	bool "Introduce snsc_did_abort_retry to control DID_ABORT retry"
	depends on SNSC
	depends on USB_STORAGE

config SNSC_USB_STORAGE_SCHED_OPTION
	bool "Set scheduler policy/priority for dispatchers"
	depends on SNSC
	depends on USB_STORAGE
	select SNSC_SET_THREAD_PRIORITY

config SNSC_USB_STORAGE_SCHED_POLICY
	int "Scheduler Policy(0=NORMAL, 1=FIFO, 2=RR)"
	depends on SNSC_USB_STORAGE_SCHED_OPTION
	default 0
	help
	  NORMAL  0 (PRIORITY=-20..19)
	  FIFO    1 (PRIORITY=1..99)
	  RR      2 (PRIORITY=1..99)
	  BATCH   3 (PRIORITY=0)
	  Another value does not change the schedule policy and priority.

config SNSC_USB_STORAGE_SCHED_PRIORITY
	int "Scheduler Priority(NORMAL:-20..19, FIFO/RR:1..99)"
	depends on SNSC_USB_STORAGE_SCHED_OPTION
	default 0
	help
	  DTG3G:    2(RR) (PRIORITY=21)
	  SELECAO:  2(RR) (PRIORITY=21)
	  DTGNEXUS: 2(RR) (PRIORITY=98)

config SNSC_USB_STORAGE_ADDITIONAL_PROC_INFO
	bool "USB Mass Storage additional proc info"
	depends on SNSC
	depends on USB_STORAGE

config SNSC_USB_STORAGE_ADDITIONAL_UNUSUAL_DEVS
	bool "Enable to operations for additional unusual devices"
	depends on SNSC
	depends on USB_STORAGE

config SNSC_USB_STOR_ENABLE_SYNCHRONIZE_CACHE_SUPPORT
	bool "Enable SYNCHRONIZE CACHE command for USB Mass Storage"
	depends on SNSC
	depends on USB_STORAGE
	select SNSC_SCSI_SD_CHK_SYNCHRONIZE_CACHE_SUPPORT

config SNSC_USB_STOR_MAX_SECTORS_OPTION
	bool "Set default max_sectors"
	depends on SNSC
	depends on USB_STORAGE

config SNSC_USB_STOR_MAX_SECTORS
	int "default max_sectors"
	depends on SNSC_USB_STOR_MAX_SECTORS_OPTION
	default 128
	help
	  In many kinds of devices, it seems that max_sectors=128
	  results in better performance than 240(default).

          If you want to know more detail about max_sectors 240,
	  please check below URL.
	    http://www.linux-usb.org/FAQ.html
            Q: What is max_sectors and how should I use it?

config SNSC_USB_STOR_UEVENT_CMD_TIMEOUT
	bool "Send an uevent when command timed out"
	depends on SNSC
	depends on USB_STORAGE
	default n
```

## fs/Kconfig.snsc
```kconfig
comment "SNSC related options"
	depends on SNSC

config SNSC_FS_FLUSH_HARDWARE_CACHE
	bool "Flush hardware cache"
	depends on SNSC
	default y
	help
	  If you want to flush hardware cache after syncing blockdev buffers,
	  say Y.

config SNSC_FS_FAT_FLUSH_HARDWARE_CACHE
	bool "Fix flush cache might not be done with batch_sync"
	depends on SNSC && SNSC_FS_FLUSH_HARDWARE_CACHE
	default y

config SNSC_FS_OSYNC_INODE_ONLY
	bool "Add generic_osync_inode_only()"
	depends on SNSC
	default n
	help

	Add generic_osync_inode_only() for fs-osync-inode.
	fs-osync-inode patch called generic_osync_inode().
	But it was obsoleted. So make new function generic_osync_inode_only().
	This function has a function that is simpler than generic_osync_inode().

config SNSC_FS_OSYNC_ATTR
	bool "Sync inode when attribute is changed"
	depends on SNSC_FS_OSYNC_INODE_ONLY
	default y
	   help
	   This option add sync operation after attribute changed, if
	   sync mount option specified.

config SNSC_FS_IOCTL_SYNC
	bool "Enable ioctl command to sync specified file system"
	depends on SNSC
	default n

config SNSC_FS_CLEAR_MAPPING_ERRORS
	bool "Clear mapping errors when partition is rescaned."
	depends on SNSC
	default n

config SNSC_FS_VFAT_POSIX_ATTR
	bool "VFAT POSIX attribute support"
	depends on SNSC && VFAT_FS
	select SNSC_FS_OSYNC_INODE_ONLY
	default n

config SNSC_FS_VFAT_POSIX_ATTR_DEFAULT_UID_VALUE
	int "Set the default uid/gid value for VFAT POSIX attribute"
	depends on SNSC_FS_VFAT_POSIX_ATTR
	default 65535

config SNSC_FS_VFAT_POSIX_ATTR_CREATE_FILE_WITH_DEFAULT_UID
	bool "Set the default uid/gid value when create new file by user."
	depends on SNSC_FS_VFAT_POSIX_ATTR
	default n

config SNSC_FS_FAT_LOOKUP_HINT
	bool "Use hint on scanning directories for FAT"
	depends on SNSC && (MSDOS_FS || VFAT_FS)
	default n

config SNSC_FS_VFAT_AVOID_DOUBLE_LINK
	bool "Fix write ordering issue on rename for VFAT"
	depends on SNSC && VFAT_FS
	default n

config SNSC_FS_VFAT_AVOID_DOUBLE_LINK_DEFAULT
	int "Default value of avoiding double link"
	depends on SNSC_FS_VFAT_AVOID_DOUBLE_LINK
	default 1

config SNSC_FS_FAT12_NO_SECTOR_BOUNDARY
	bool "Allocate no new entry which accross sector boundary for FAT12"
	depends on SNSC && (MSDOS_FS || VFAT_FS)
	default n

config SNSC_FS_FAT_UNIX_DATE
	bool "Check and correct invalid date over time_t range for FAT"
	depends on SNSC && (MSDOS_FS || VFAT_FS)
	default n

config SNSC_FS_FAT_RELAX_SYNC
	bool "Loose I/O submission ordering control with 'sync' for FAT"
	depends on SNSC && (MSDOS_FS || VFAT_FS)
	default n
	help
	   This option introduces an new option "relax_sync", works with "sync".
	   This makes I/O submission ordering control loose a little bit.  For
	   instance, with this option, fat permits potential I/O request merge
	   for file allocation table and async file allocation table mirroring.

config SNSC_FS_FAT_GC
	bool "Enable 'gc' option for FAT"
	depends on SNSC && (MSDOS_FS || VFAT_FS)
	default n
	help
	   This option introduces an new option "gc".

config SNSC_FS_FAT_BATCH_SYNC
	bool "Enable 'batch_sync' option for FAT"
	depends on SNSC && (MSDOS_FS || VFAT_FS)
	default n
	help
	   This option introduces an new option "batch_sync".

config SNSC_FS_FAT_FIX_UTF8
	bool "Enable to skip long name over d_name length"
	depends on SNSC && (MSDOS_FS || VFAT_FS)
	default y

config SNSC_FS_ROOT_VFAT
	bool "Root file system on VFAT"
	depends on SNSC_FS_VFAT_POSIX_ATTR
	help
	   If you have enabled VFAT POSIX attribute support, and you want
	   to be able to use the VFAT image as a root file system, say Y.

config SNSC_FS_VFAT_COMPARE_UNICODE
	bool "Enable 'comp_uni' option for VFAT"
	depends on SNSC && VFAT_FS
	default n
	help
	   This option introduces an new option "comp_uni".

config SNSC_FS_FAT_TIMEZONE
	bool "Enable 'timezone' option for FAT"
	depends on SNSC && (MSDOS_FS || VFAT_FS)
	default n
	help
	   This option introduces an new option "timezone".

config SNSC_FS_VFAT_CLEAN_SHUTDOWN_BIT
	bool "Enable 'clnshutbit' option for VFAT"
	depends on SNSC && VFAT_FS
	default n
	help
	   This option introduces an new option "clnshutbit".

config SNSC_FS_VFAT_IGNORE_CRTIME
	bool "Enable 'ignore_crtime' option for VFAT"
	depends on SNSC && VFAT_FS
	default n
	help
	   This option introduces an new option "ignore_crtime".

config SNSC_FS_FAT_STRICT_CHECK_ON_BOOT_SECTOR
	bool "Enables strict check on fat boot sector"
	depends on SNSC && (MSDOS_FS || VFAT_FS)

config SNSC_FS_VFAT_CHECK_DISK
	bool "Enables 'check_disk' option for VFAT"
	depends on SNSC && VFAT_FS && SNSC_BLOCK_K3D

config SNSC_FS_FAT_FLUSH_NO_WAIT_AT_CLOSING_CLEAN_FILES
	bool "Avoid wait at closing clean files"
	depends on SNSC && (MSDOS_FS || VFAT_FS)
	default y
	help
	   Avoid wait at closing clean files when 'flush' option is specified.

config SNSC_FS_FAT_IOCTL_EXPAND_SIZE
	bool "Enable ioctl command to expand file size without filling a gap"
	depends on SNSC && (MSDOS_FS || VFAT_FS)
	default n

config SNSC_FS_FAT_IOCTL_CONCAT_DIRTY_PAGES
	bool "Enable ioctl command to concatenate dirty pages within a cluster"
	depends on SNSC && (MSDOS_FS || VFAT_FS)
	default n

config SNSC_FS_FAT_KEEP_CONSISTENCY_ON_SSBOOT
	bool "Keep consistency without umount on Snapshot Boot for FAT"
	depends on SNSC && (MSDOS_FS || VFAT_FS)
	depends on SNSC_SSBOOT
	depends on SNSC_SAFE_SUSPEND
	default y

config SNSC_FS_FLUSH_DCACHE_IN_VFS
	bool "Flush the D-cache in the VFS (mpage) layer"
	default n
	help
	   This shouldn't be needed if the drivers using PIO called
	   flush_dcache_page(). This allows such drivers to be used
	   with filesystems like ext2/3.
```

## init/Kconfig.snsc
```kconfig
#
# SNSC related configurations
#

config SNSC_NLVER_CUSTOMVER_ENABLE
       bool 'Use custom kernel version'
       depends on SNSC

config SNSC_NLVER_CUSTOMVER
       string 'Custom kernel version'
       depends on SNSC_NLVER_CUSTOMVER_ENABLE
       depends on SNSC

config SNSC_NLVER_REPOSITORYVERSION_AUTO
       bool 'Embed git/arch repository revision'
       depends on SNSC

config SNSC_NLVER_NBLVER
       bool 'Add support of NBL version'
       depends on SNSC
       depends on SNSC_NBLARGS
       default n

config SNSC_DEFERRED_INITCALLS
	bool 'Support for deferred initcalls'
	depends on SNSC
	depends on ARM
	default n

config SNSC_DEFERRED_INITCALLS_SCSI
	bool 'Enable deferred initcalls for SCSI'
	depends on SNSC_DEFERRED_INITCALLS
	depends on SCSI
	default n

config SNSC_DEFERRED_INITCALLS_GROUP_BLK_DEV_SD
	int 'Group number for SCSI disk driver (0-31)'
	depends on SNSC_DEFERRED_INITCALLS_SCSI
	depends on BLK_DEV_SD
	default 16

config SNSC_DEFERRED_INITCALLS_USB
	bool 'Enable deferred initcalls for USB'
	depends on SNSC_DEFERRED_INITCALLS
	depends on USB
	default n

config SNSC_DEFERRED_INITCALLS_GROUP_USB_HCD
	int 'Group number for USB Host Controller drivers (0-31)'
	depends on SNSC_DEFERRED_INITCALLS_USB
	depends on USB_EHCI_HCD || USB_OHCI_HCD
	default 16

config SNSC_DEFERRED_INITCALLS_GROUP_USB_STORAGE
	int 'Group number for USB Storage driver (0-31)'
	depends on SNSC_DEFERRED_INITCALLS_USB
	depends on USB_STORAGE
	default 16

config SNSC_DEFERRED_INITCALLS_GROUP_USB_VIDEO_CLASS
	int 'Group number for USB Video Class driver (0-31)'
	depends on SNSC_DEFERRED_INITCALLS_USB
	depends on USB_VIDEO_CLASS
	default 16
```

## kernel/Kconfig.snsc
```kconfig
#
# SNSC related configurations
#

config SNSC_SET_THREAD_PRIORITY
	bool
	depends on SNSC
	default n
```

## kernel/power/Kconfig.snsc
```kconfig
#
# SNSC related configurations
#

config SNSC_PM_SCHED_NORMAL_AT_FREEZE
	bool "Change scheduling policy to normal at freezing tasks"
	depends on SNSC
	depends on PM_SLEEP
	default n
```

## lib/Kconfig.debug_snsc
```kconfig
menu "SNSC Configurations"

comment "SNSC debug options"
	depends on SNSC

endmenu
```
